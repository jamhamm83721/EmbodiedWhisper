## firmware/glasses/main/Kconfig.projbuild
```kconfig
menu "EmbodiedWhisper network"
    config EW_WIFI_SSID
        string "Wi-Fi SSID"
        default ""
    config EW_WIFI_PASSWORD
        string "Wi-Fi password"
        default ""
    config EW_SERVER_IPV4
        string "Receiving computer IPv4 address"
        default "192.0.2.1"
        help
            Replace this documentation address with your receiving computer's
            address on the same local network.
    config EW_SERVER_PORT
        int "Receiving computer TCP port"
        range 1 65535
        default 9090
endmenu
```

## firmware/glasses/sdkconfig.defaults
```kconfig
CONFIG_ESPTOOLPY_FLASHSIZE_16MB=y
CONFIG_PARTITION_TABLE_CUSTOM=y
CONFIG_PARTITION_TABLE_CUSTOM_FILENAME="partitions-16MiB.csv"
CONFIG_SPIRAM=y
CONFIG_SPIRAM_MODE_OCT=y
CONFIG_SPIRAM_SPEED_80M=y
CONFIG_SPIRAM_USE_MALLOC=y
CONFIG_SPIRAM_MALLOC_ALWAYSINTERNAL=16384
CONFIG_SPIRAM_MALLOC_RESERVE_INTERNAL=32768
CONFIG_FREERTOS_HZ=1000
CONFIG_OV5640_SUPPORT=y
CONFIG_CAMERA_TASK_STACK_SIZE=2048
CONFIG_CAMERA_CORE0=y
CONFIG_CAMERA_DMA_BUFFER_SIZE_MAX=32768
```
